## xeal_sama5d2_v1.its
```
/dts-v1/;

/ {
  description = "Xeal SAMA5D2 v1 FIT Image";
  #address-cells = <1>;

  images {
    kernel@1 {
      description = "Linux4SAM Linux kernel";
      data = /incbin/("./zImage");
      type = "kernel";
      arch = "arm";
      os = "linux";
      compression = "none";
      load = <0x22000000>;
      entry = <0x22000000>;
      hash@1 {
        algo = "crc32";
      };
      hash@2 {
        algo = "sha1";
      };
    };

    base_fdt {
      description = "Flattened Device Tree blob";
      data = /incbin/("./at91-sama5d2_xplained.dtb");
      type = "flat_dt";
      arch = "arm";
      compression = "none";
      load = <0x23000000>;
      hash@1 {
        algo = "crc32";
      };
      hash@2 {
        algo = "sha1";
      };
    };

    xeal_sama5d2_v1_fdt {
      description = "Device Tree blob Xeal SAMA5D2 v1 board overlay";
      data = /incbin/("./xeal_sama5d2_v1/xeal_sama5d2_v1_base.dtbo");
      type = "flat_dt";
      arch = "arm";
      compression = "none";
      load = <0x23100000>;
      hash@1 {
        algo = "crc32";
      };
      hash@2 {
        algo = "sha1";
      };
    };
  };

  configurations {
    default = "kernel_dtb";

    kernel_dtb {
      description = "Linux kernel and base FDT blob for XEAL_SAMA5D2_V1 board";
      kernel = "kernel@1";
      fdt = "base_fdt";
    };

    base_dtb {
      description = "Base FDT blob for XEAL_SAMA5D2_V1 board";
      fdt = "base_fdt";
    };

    xeal_sama5d2_v1 {
      description = "Product-specific FDT blob for Xeal SAMA5D2 v1 board";
      fdt = "xeal_sama5d2_v1_fdt";
    };
  };
};
 
```
